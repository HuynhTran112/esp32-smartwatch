## main/Kconfig.projbuild
```kconfig
menu "Smartwatch OTA"

config OTA_FIRMWARE_URL
    string "HTTPS firmware binary URL"
    default ""
    help
        HTTPS URL pointing to the ESP-IDF application .bin used by OTA.
        Leave empty to disable OTA from the UI.

endmenu

menu "Smartwatch BLE Security"

config WATCH_BLE_PAIR_PASSKEY
    int "BLE pairing static passkey"
    range 0 999999
    default 123456
    help
        Static 6-digit passkey used for BLE Secure Connections MITM pairing.
        The phone must enter this passkey before encrypted GATT read/write is allowed.

endmenu

menu "Smartwatch Debug"

config WATCH_HEAP_MONITOR
    bool "Enable periodic heap monitor log"
    default n
    help
        Logs heap, internal heap, and PSRAM every 30 seconds.
        Keep disabled for production firmware.

endmenu
```

## sdkconfig.defaults
```kconfig
# ===== LVGL Fonts =====
CONFIG_LV_FONT_MONTSERRAT_14=y

# ===== LVGL Display =====
CONFIG_LV_COLOR_16_SWAP=y

# ===== Touch CST816S =====
# Some CST816-series panels fail init when the driver reads the chip ID.
CONFIG_ESP_LCD_TOUCH_CST816S_DISABLE_READ_ID=y

# ===== Flash + SPIRAM (ESP32-S3 N16R2) =====
CONFIG_SPIRAM=y
CONFIG_SPIRAM_MODE_QUAD=y
CONFIG_SPIRAM_SPEED_80M=y
CONFIG_SPIRAM_USE_MALLOC=y
CONFIG_SPIRAM_MALLOC_RESERVE_INTERNAL=32768
CONFIG_SPIRAM_MALLOC_ALWAYSINTERNAL=32

# ===== Flash Size =====
CONFIG_ESPTOOLPY_FLASHSIZE_16MB=y
CONFIG_ESPTOOLPY_FLASHSIZE="16MB"

# ===== Performance =====
CONFIG_ESP_DEFAULT_CPU_FREQ_MHZ_240=y
CONFIG_COMPILER_OPTIMIZATION_PERF=y
CONFIG_PM_ENABLE=y
CONFIG_PM_DFS_INIT_AUTO=y
CONFIG_FREERTOS_USE_TICKLESS_IDLE=y
CONFIG_FREERTOS_IDLE_TIME_BEFORE_SLEEP=3
CONFIG_RTC_CLK_SRC_EXT_CRYS=y
CONFIG_RTC_CLK_CAL_CYCLES=3000

# ===== FreeRTOS =====
CONFIG_FREERTOS_HZ=1000
CONFIG_FREERTOS_TIMER_TASK_STACK_DEPTH=2048

# ===== Stack Overflow Detection =====
CONFIG_FREERTOS_CHECK_STACKOVERFLOW_CANARY=y
# CONFIG_FREERTOS_WATCHPOINT_END_OF_STACK is not set
# CONFIG_FREERTOS_USE_TRACE_FACILITY is not set
# CONFIG_FREERTOS_GENERATE_RUN_TIME_STATS is not set
# CONFIG_FREERTOS_USE_STATS_FORMATTING_FUNCTIONS is not set

# ===== Smartwatch Debug =====
# CONFIG_WATCH_HEAP_MONITOR is not set

# ===== Bluetooth =====
CONFIG_BT_ENABLED=y
CONFIG_BT_BLUEDROID_ENABLED=y
CONFIG_BT_BLE_DYNAMIC_ENV_MEMORY=y
CONFIG_BT_ALLOCATION_FROM_SPIRAM_FIRST=y
CONFIG_BT_ACL_CONNECTIONS=1
# CONFIG_BT_MULTI_CONNECTION_ENBALE is not set
CONFIG_BT_SMP_MAX_BONDS=4
CONFIG_BT_BLE_RPA_TIMEOUT=86400
# CONFIG_BT_GATTC_ENABLE is not set
CONFIG_BT_GATT_MAX_SR_PROFILES=1
CONFIG_BT_GATT_MAX_SR_ATTRIBUTES=24
CONFIG_BT_CTRL_MODEM_SLEEP=y
CONFIG_BT_CTRL_MODEM_SLEEP_MODE_1=y
CONFIG_BT_CTRL_LPCLK_SEL_EXT_32K_XTAL=y
CONFIG_BT_CTRL_DFT_TX_POWER_LEVEL_P3=y

# ===== Partition Table =====
CONFIG_PARTITION_TABLE_CUSTOM=y
CONFIG_PARTITION_TABLE_CUSTOM_FILENAME="partitions_custom.csv"
CONFIG_PARTITION_TABLE_FILENAME="partitions_custom.csv"

# ===== Task Watchdog (tăng timeout để tránh trigger sai) =====
CONFIG_ESP_TASK_WDT_TIMEOUT_S=15
CONFIG_ESP_TASK_WDT_PANIC=y

# ===== LVGL Memory (dùng malloc từ PSRAM) =====
CONFIG_LV_MEM_CUSTOM=y
# CONFIG_SPIRAM_ALLOW_STACK_EXTERNAL_MEMORY is not set

# ===== LVGL Release Footprint =====
# CONFIG_LV_BUILD_EXAMPLES is not set
# CONFIG_LV_USE_PERF_MONITOR is not set
# CONFIG_LV_USE_MEM_MONITOR is not set
# CONFIG_LV_USE_DROPDOWN is not set
# CONFIG_LV_USE_TABLE is not set
# CONFIG_LV_USE_CANVAS is not set
# CONFIG_LV_USE_CHECKBOX is not set
# CONFIG_LV_USE_TEXTAREA is not set
# CONFIG_LV_USE_ANIMIMG is not set
# CONFIG_LV_USE_CALENDAR is not set
# CONFIG_LV_USE_CHART is not set
# CONFIG_LV_USE_COLORWHEEL is not set
# CONFIG_LV_USE_IMGBTN is not set
# CONFIG_LV_USE_KEYBOARD is not set
# CONFIG_LV_USE_LED is not set
# CONFIG_LV_USE_LIST is not set
# CONFIG_LV_USE_MENU is not set
# CONFIG_LV_USE_METER is not set
# CONFIG_LV_USE_MSGBOX is not set
# CONFIG_LV_USE_SPAN is not set
# CONFIG_LV_USE_SPINBOX is not set
# CONFIG_LV_USE_SPINNER is not set
# CONFIG_LV_USE_TABVIEW is not set
# CONFIG_LV_USE_WIN is not set
# CONFIG_LV_USE_SNAPSHOT is not set

# ===== Wi-Fi Memory Optimization =====
CONFIG_ESP_WIFI_STATIC_RX_BUFFER_NUM=4
CONFIG_ESP_WIFI_DYNAMIC_RX_BUFFER_NUM=16
CONFIG_ESP_WIFI_STATIC_TX_BUFFER_NUM=4
CONFIG_ESP_WIFI_TX_BA_WIN=2
CONFIG_LWIP_MAX_SOCKETS=4
CONFIG_LWIP_TCP_SND_BUF=4096
CONFIG_LWIP_TCP_WND_DEFAULT=4096

# ===== Bluetooth Compatibility =====
CONFIG_BT_BLE_42_FEATURES_SUPPORTED=y

# ===== OTA =====
# Disabled until a real HTTPS firmware .bin URL is provided.
CONFIG_OTA_FIRMWARE_URL=""
CONFIG_WATCH_BLE_PAIR_PASSKEY=123456
```
